## labs/04-secure-boot-emulation/firmware/sdkconfig.defaults
```kconfig
CONFIG_ESP32C3_REV_MIN_3=y
CONFIG_SECURE_BOOT=y
CONFIG_SECURE_BOOT_V2_ENABLED=y
CONFIG_SECURE_BOOT_BUILD_SIGNED_BINARIES=y
CONFIG_SECURE_BOOT_SIGNING_KEY=".private/secure-boot-signing-key.pem"
CONFIG_SECURE_BOOT_FLASH_BOOTLOADER_DEFAULT=y
CONFIG_ESPTOOLPY_FLASHSIZE_4MB=y
CONFIG_PARTITION_TABLE_OFFSET=0xC000
```

## labs/12-ota-vs-secure-ota/profile-01-insecure-channel/firmware/ota-client/main/Kconfig.projbuild
```kconfig
menu "Lab OTA Configuration"

    config LAB_OTA_URL
        string "Insecure HTTP OTA URL"
        default "http://192.168.4.2:8070/untrusted_update.bin"
        help
            URL served only inside the isolated lab network. This profile is
            intentionally insecure and uses HTTP without server authentication.

    config LAB_OTA_START_DELAY_SECONDS
        int "Delay before starting OTA"
        range 1 60
        default 5
        help
            Gives the serial monitor time to show the running partition and
            the security warning before the download starts.

endmenu
```

## labs/12-ota-vs-secure-ota/profile-01-insecure-channel/firmware/ota-client/sdkconfig.defaults
```kconfig
CONFIG_ESP32C3_REV_MIN_3=y
CONFIG_ESPTOOLPY_FLASHSIZE_4MB=y
CONFIG_PARTITION_TABLE_CUSTOM=y
CONFIG_PARTITION_TABLE_CUSTOM_FILENAME="../partitions.csv"
CONFIG_ESP_HTTPS_OTA_ALLOW_HTTP=y
CONFIG_EXAMPLE_CONNECT_WIFI=y
CONFIG_EXAMPLE_WIFI_SSID="LAB_NOT_CONFIGURED"
CONFIG_EXAMPLE_WIFI_PASSWORD="LAB_NOT_CONFIGURED"
CONFIG_LAB_OTA_URL="http://192.168.4.2:8070/untrusted_update.bin"
CONFIG_LAB_OTA_START_DELAY_SECONDS=5
CONFIG_APP_PROJECT_VER_FROM_CONFIG=y
CONFIG_APP_PROJECT_VER="insecure-client-1.0.0"
```

## labs/12-ota-vs-secure-ota/profile-01-insecure-channel/firmware/untrusted-update/sdkconfig.defaults
```kconfig
CONFIG_ESP32C3_REV_MIN_3=y
CONFIG_ESPTOOLPY_FLASHSIZE_4MB=y
CONFIG_PARTITION_TABLE_CUSTOM=y
CONFIG_PARTITION_TABLE_CUSTOM_FILENAME="../partitions.csv"
CONFIG_APP_PROJECT_VER_FROM_CONFIG=y
CONFIG_APP_PROJECT_VER="untrusted-update-1.0.0"
```
